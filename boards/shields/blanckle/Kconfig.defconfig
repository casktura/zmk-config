## boards/shields/blanckle/Kconfig.defconfig
```kconfig
# Copyright (c) 2025 The ZMK Contributors
# SPDX-License-Identifier: MIT

if SHIELD_BLANCKLE

config ZMK_KEYBOARD_NAME
    default "BlanckLE"

endif
```

## boards/shields/blanckle/Kconfig.shield
```kconfig
# Copyright (c) 2025 The ZMK Contributors
# SPDX-License-Identifier: MIT

config SHIELD_BLANCKLE
    def_bool $(shields_list_contains,blanckle)
```

## config/west.yml
```yaml
manifest:
  remotes:
    - name: zmkfirmware
      url-base: https://github.com/zmkfirmware
    - name: petejohanson
      url-base: https://github.com/petejohanson
    - name: keyboardio
      url-base: https://github.com/keyboardio
    - name: hitsmaxft
      url-base: https://github.com/hitsmaxft
  projects:
    - name: zmk
      remote: zmkfirmware
      revision: main
      import: app/west.yml
    - name: blank-slate-zmk-module
      remote: petejohanson
      revision: main
    - name: keyboardio-preonic-zmk-module
      remote: keyboardio
      revision: main
    - name: zmk-rgbled-widget
      remote: hitsmaxft
      revision: main
  self:
    path: config
```
